## config/boards/shields/shi_key/Kconfig.defconfig
```kconfig
if SHIELD_SHI_KEY

config ZMK_KEYBOARD_NAME
    default "ShiKey"

config ZMK_BLE
    default y

config ZMK_SLEEP
    default y

endif
```

## config/boards/shields/wm_tenkeys/Kconfig.defconfig
```kconfig
if SHIELD_WM_TENKEYS

config ZMK_KEYBOARD_NAME
    default "WMTenKeys"

config ZMK_BLE
    default y

endif
```
